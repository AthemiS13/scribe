//goofy functionality, but animations work


#include <Arduino.h>
#include <Wire.h>
#include <U8g2lib.h>
#include <BluetoothSerial.h>

BluetoothSerial SerialBT; // Bluetooth serial instance
U8G2_SSD1306_128X32_UNIVISION_F_HW_I2C u8g2(U8G2_R0, /* SCL=*/ 9, /* SDA=*/ 8);

bool btConnected = false; // Bluetooth connection state
unsigned long lastUpdate = 0;
int dots = 0;
static const unsigned char image_download_bits[] = {0x00,0x00,0x00,0x00,0x00,0x00,0x00,0x00,0x00,0x00,0x00,0x00,0x00,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0x00,0x00};
static const unsigned char bt_disconnected[] = {0x40,0x00,0xc1,0x00,0x42,0x01,0x44,0x02,0x48,0x04,0x10,0x04,0x20,0x02,0x40,0x00,0xa0,0x00,0x50,0x01,0x48,0x02,0x44,0x04,0x40,0x0a,0x40,0x11,0x80,0x20,0x00,0x00};

void setup() {
  u8g2.begin();
  u8g2.clearBuffer();
  
  // Show the logo (Paste your logo code from LOPAKA assets here)
  u8g2.drawXBM(0, -1, 128, 64, image_download_bits);
  u8g2.sendBuffer();
  delay(2000); // Hold logo for 2 seconds
  
  // Initialize Bluetooth
  SerialBT.begin("SmartPen");
  SerialBT.register_callback(btCallback); // Set callback for BT events
  
  // Show "Searching..." with animation
  showConnectionStatus("Searching", false);
}

void loop() {
  if (btConnected) {
    showConnectionStatus("Connected", true);
    u8g2.clearBuffer();
    u8g2.drawStr(0, 20, "Waiting for text...");
    u8g2.sendBuffer();
    delay(1000);
  } else {
    animateLoading("Searching");
  }
}

// Bluetooth callback
void btCallback(esp_spp_cb_event_t event, esp_spp_cb_param_t *param) {
  if (event == ESP_SPP_SRV_OPEN_EVT) {
    btConnected = true;
  } else if (event == ESP_SPP_CLOSE_EVT) {
    btConnected = false;
  }
}

// Show Bluetooth status and loading animation
void showConnectionStatus(const char* text, bool connected) {
  u8g2.clearBuffer();
  u8g2.setFont(u8g2_font_ncenB08_tr);
  u8g2.drawStr(0, 15, text);
  
  // Draw Bluetooth icon (paste Bluetooth icon assets here from LOPAKA)
  if (connected) {
    u8g2.drawXBM(114, 1, 14, 16, bt_connected);
  } else {
    u8g2.drawXBM(114, 1, 14, 16, bt_disconnected);
  }
  u8g2.sendBuffer();
}

void animateLoading(const char* message) {
  unsigned long currentMillis = millis();
  
  if (currentMillis - lastUpdate > 500) { // Update every 500ms
    lastUpdate = currentMillis;
    dots = (dots + 1) % 4; // Rotate dots

    u8g2.clearBuffer();
    u8g2.setFont(u8g2_font_ncenB08_tr);
    u8g2.drawStr(0, 15, message);

    // Add animated dots
    for (int i = 0; i < dots; i++) {
      u8g2.drawStr(60 + (i * 4), 15, ".");
    }

    // Draw Bluetooth icon based on connection status
    if (btConnected) {
      u8g2.drawXBM(114, 1, 14, 16, bt_connected);
    } else {
      u8g2.drawXBM(114, 1, 14, 16, bt_disconnected);
    }

    u8g2.sendBuffer();
  }
}
